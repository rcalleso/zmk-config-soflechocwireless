## config/west.yml
```yaml
manifest:
  remotes:
    - name: zmkfirmware
      url-base: https://github.com/zmkfirmware
  projects:
    - name: zmk
      remote: zmkfirmware
      revision: main  # <-- Cambia v0.0.1 por main o la rama correspondiente
      import: app/west.yml
  self:
    path: config
```
